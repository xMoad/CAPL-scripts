/*@!Encoding:1252*/

variables
{
  msTimer Timer_1;
 // msTimer Timer_2;
  //msTimer Timer_3;
  msTimer Timer_4;
  msTimer Timer_5;
  
  message	CAN2.iBESP2		iBESP2;	//trigger parameter
	message CAN1.ID_201		ID_201;	//Position_target parameter frame
  
 /* int A = 0;                  //0
  int B = 0x2710;             //10000
  int C = 0x2EE0;             //12000
  int temp = 0;               //Variable temp [0::9514]x10
  */
  int triggerParam;
  long titi;
  //signal triggerParam = iBESP2.iBESP2_pRunout2;
  
  //triggerParam =iBESP2.iBESP2_pRunout;
  //int trigger  = iBESP2.iBESP2_pRunout; 
  
 

}

on start
{
  ID_201.Task_Actuator.phys	=	4;
	ID_201.Position_target.phys = 10000;
	ID_201.Application_speed.phys = 30;
  
  output(ID_201);
}

on message iBESP2
{
 ID_201.Task_Actuator.phys	=	4;
	ID_201.Position_target.phys = 10000;
	ID_201.Application_speed.phys = 30;
  
  output(ID_201);
  titi = this.iBESP2_pRunout;
  write("message ID= %d is received from channel %d", this.id, this.can);
  write("the signal value of pRunout de merde is %d", titi);
  //canSetChannelMode(2,0,0);
  //setCanCabsMode(0,2,0,0);
  if(titi == 0)
  {
    canSetChannelAcc(2,24,24);
    setTimer(Timer_1, 0);
    
  }
  
  write("the signal value of pRunout //// is %d", titi);

}

/*

on start
{
  //write("message ID= %d is received from channel %d", iBESP2.id, iBESP2.can);
  write("the signal value of pRunout de merde is %d", iBESP2.iBESP2_pRunout);
  
  //titi = diagResponse::GetParameter("
  titi = getMessageAttrInt( iBESP2, "iBESP2_pRunout");
  
  write("Start of loop - Initialization Position at 0");
  
  write("pRunout Value %f", getMessageAttrInt( iBESP2, "iBESP2_pRunout"));
  
  write("valeur de pRunout byte %f",iBESP2.iBESP2_pRunout.DefaultValue );
  iBESP2.iBESP2_pRunout = 1;
   write("valeur de pRunout %f", iBESP2.iBESP2_pRunout);
 //triggerParam = getValue(iBESP2.iBESP2_pRunout);
  ID_201.Task_Actuator.phys	=	4;
	ID_201.Position_target.phys = 0;
	ID_201.Application_speed.phys = 30;
  
  output(ID_201);
  
  setTimer(Timer_1, 6000);   

}
*/
on key's' 
{
  cancelTimer(Timer_1);
  //cancelTimer(Timer_2);
  //cancelTimer(Timer_3);
  cancelTimer(Timer_4);
  cancelTimer(Timer_5);
 
}


  
//Position = 0; t = 6s; V = 30mm/s
on timer Timer_1
{
  write("valeur de pRunout Timer_1 %d", triggerParam);

  write("Timer_1 - Consigne de position à 0 pendant 30s");
  ID_201.Task_Actuator.phys	=	4;
	ID_201.Position_target.phys = 0;
	ID_201.Application_speed.phys = 30;
  
  output(ID_201);
  
  setTimer(Timer_4, 30000);
 
}

/*
//position = 10000; t = 6s au max; v= 30mm/s
on timer Timer_2
{
 
  write("Timer_2 - Consigne de position à 0 pendant 4s");
  ID_201.Task_Actuator.phys	=	4;
	ID_201.Position_target.phys = 0;
	ID_201.Application_speed.phys = 30;
  
  output(ID_201);
   
  setTimer(Timer_4, 8000); 

}
*/

on timer Timer_4
{
  write("Timer_4 - Consigne de position à 12000 pendant 330ms");
  ID_201.Task_Actuator.phys	=	4;
	ID_201.Position_target.phys = 12000;
	ID_201.Application_speed.phys = 30;
  
  output(ID_201);
  
  setTimer(Timer_5, 330);
}

//Position = 0; t = 330ms; V = 30mm/s
on timer Timer_5
{
  write("Timer_5 - Consigne de position à 0 pendant 330ms");
  ID_201.Task_Actuator.phys	=	4;
	ID_201.Position_target.phys = 0;
	ID_201.Application_speed.phys = 30;
  
  output(ID_201);
  
  setTimer(Timer_4, 330);
}
