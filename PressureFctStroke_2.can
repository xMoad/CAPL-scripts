/*@!Encoding:1252*/


variables
{
  msTimer Timer_1;
  msTimer Timer_2;
  msTimer Timer_3;
  msTimer Timer_4;
  msTimer Timer_5;
  //msTimer Timer_6;
  //msTimer Timer_7;
  //msTimer Timer_8;
  msTimer Timer_9;
  msTimer Timer_10;
  msTimer Timer_11;
  msTimer Timer_12;
  //msTimer Timer_13;
  msTimer Timer_14;
  msTimer Timer_15;
  //msTimer Timer_16;
  //msTimer Timer_17;
  msTimer Timer_18;
  
  message CAN1.Parker_advanced::ID_201      ID_201;	              //Position_target parameter frame
  message CAN1.Parker_advanced::NMT         NMT;
  message CAN2.VW_Golf_GTE::ACW_08_11     	pMC1_L;              //trigger parameter

  float triggerParam;
  int comptDummy = 0;
  int Vitesse = 50;
  int CourseMaintien = 4000;
  int state_reg=0;
  float pReg_p1, pReg_p2;
  float pIndic = 0;
  float pCalc = 0;
  int moduloCompt = 0;
  int course_p1;       
  int course_p2;       
  int waitTime = 0;
}
on preStart
{
  ID_201.Task_Actuator.phys	=	1;
  ID_201.Position_target.phys = 0;
  ID_201.Application_speed.phys = 0;
  NMT.NMT.phys = 1;
  
  output(NMT);
  output(ID_201); 
  write("ON START - ACTIVATE & INIT ACTUATOR");
}
on Start
{
  state_reg = 0;
  ///////////////////////////////////////////////////////////////////////////////////////
  course_p1 = 17400;       //10 - 8.6
  course_p2 = 14400;       //8 - 6.6  
  waitTime = 2500;
  //////////////////////////////////////////////////////////////////////////////////////
  write("ON START - INIT ACTUATOR VALUE PER Pressure");
}

on message VW_Golf_GTE::ACW_08_11
{
  //canSetChannelAcc(2,0,0);
  
  write("Stroke_p1 %d  -- Stroke_p2 %d",course_p1, course_p2); 
  write("ON MESSAGE - INIT  -- pReg calibration"); 
  write("pMC1_L value = %f",pCalc);
  write("flag reg = %d",state_reg);
  
  ///////////////////////////////////////////////////////////////////////////////////////////////////////////////////////////////////////////
	
  pIndic = this.PMC1_L;
	pCalc = pIndic*0.0121607-1.0823;
	pReg_p1 = pCalc;
  
	if(state_reg < 5)
  {
      pIndic = this.PMC1_L;
	    pCalc = pIndic*0.0121607-1.0823;
      pReg_p1 = pCalc;
      
      write("pReg p1 = %f", pReg_p1);
      if(pReg_p1 <= 21){course_p1 += 100;}
      if(pReg_p1 >= 23){course_p2 -= 100;}
      write("appel fct pRegP1");canSetChannelAcc(2,1,1);setTimer(Timer_11, 1000);
  }  
     
    if(state_reg < 10 && state_reg >=5)
      {
        pIndic = this.PMC1_L;
	      pCalc = pIndic*0.0121607-1.0823;
        pReg_p2 = pCalc;
      
        write("pReg p2 = %f", pReg_p2);
        if(pReg_p2 <= 53){course_p2 += 100;}
        if(pReg_p2 >= 55){course_p2 -= 100;}
        write("appel fct pRegP2");canSetChannelAcc(2,1,1);setTimer(Timer_12, 1000);
      }
      
    if(state_reg >= 10){canSetChannelAcc(2,1,1);setTimer(Timer_18,500);}
}

on timer Timer_18
{
  write("timer_18");
  ID_201.Task_Actuator.phys	=	4;
	ID_201.Position_target.phys = course_p1;
	ID_201.Application_speed.phys = Vitesse;
  output(ID_201);
  
  setTimer(Timer_1,1000);
}

on timer Timer_1
{
  write("timer_1");
  ID_201.Task_Actuator.phys	=	4;
	ID_201.Position_target.phys = course_p1;
	ID_201.Application_speed.phys = Vitesse;
  output(ID_201);
  
  setTimer(Timer_2,4500);
}

on timer Timer_2
{
  write("timer_2");
  ID_201.Task_Actuator.phys	=	4;
	ID_201.Position_target.phys = course_p2;
	ID_201.Application_speed.phys = Vitesse;
  output(ID_201);
  
  setTimer(Timer_3, 500);
}

on timer Timer_3
{
  write("timer_3");
  ID_201.Task_Actuator.phys	=	4;
  ID_201.Position_target.phys = course_p2;
  ID_201.Application_speed.phys = Vitesse;
  output(ID_201);
 
  setTimer(Timer_4, 15000);
}

on timer Timer_4
{
  write("timer_4");
  ID_201.Task_Actuator.phys	=	4;
  ID_201.Position_target.phys = 0;
  ID_201.Application_speed.phys = 200;
  output(ID_201);
 
  setTimer(Timer_5, 500); 
}

on timer Timer_5
{
  write("timer_5");
  ID_201.Task_Actuator.phys	=	4;
  ID_201.Position_target.phys = 0;
  ID_201.Application_speed.phys = Vitesse;
  output(ID_201); 
  
  setTimer(Timer_9, 7000);
}

on timer Timer_9
{
  write("timer_9");
  comptDummy ++;
  write("compt %d",comptDummy);
  moduloCompt = comptDummy%3;
  write("compt modulo %d",comptDummy%3);
  
  if(moduloCompt == 0)
  {
    state_reg = 0;
    comptDummy = 0;
    write("acess Timer10");
    setTimer(Timer_10,10000);   //50000           //instead of waiting 50s we will wait only 20s to allow the calculation of pressure during this time
  }
  if(moduloCompt != 0){setTimer(Timer_1, 10000);}
}

on timer Timer_10
{
  write("timer_10");  
  canSetChannelAcc(2,0,0);
}

on timer Timer_11
{
  write("Timer_11 - Regul 45bar");
  ID_201.Task_Actuator.phys	=	4;
  ID_201.Position_target.phys = course_p1;
  ID_201.Application_speed.phys = Vitesse;
  
  output(ID_201);
  
  setTimer(Timer_14, 500);
  state_reg ++;
}
on timer Timer_14
{
  canSetChannelAcc(2,0,0);
}

on timer Timer_12
{
  write("Timer_12 - Regul 30bar");
  ID_201.Task_Actuator.phys	=	4;
  ID_201.Position_target.phys = course_p2;
  ID_201.Application_speed.phys = Vitesse;
  output(ID_201);
  
  setTimer(Timer_15, 500);
  state_reg++;
}

on timer Timer_15
{
   canSetChannelAcc(2,0,0);  
}

on key's' 
{
  cancelTimer(Timer_1);
  cancelTimer(Timer_2);
  cancelTimer(Timer_3);
  cancelTimer(Timer_4);
  cancelTimer(Timer_5);
  cancelTimer(Timer_10);
  cancelTimer(Timer_11);
  cancelTimer(Timer_12);
  
  write("Stop script");
  
  ID_201.Task_Actuator.phys	=	4;
	ID_201.Position_target.phys = 0;
	ID_201.Application_speed.phys = Vitesse;
  output(ID_201); 
}
on stopMeasurement
{
  cancelTimer(Timer_1);
  cancelTimer(Timer_2);
  cancelTimer(Timer_3);
  cancelTimer(Timer_4);
  cancelTimer(Timer_5);
  cancelTimer(Timer_10);
  cancelTimer(Timer_11);
  cancelTimer(Timer_12);
  
  write("Stop script");
  
  ID_201.Task_Actuator.phys	=	4;
  ID_201.Position_target.phys = 0;
  ID_201.Application_speed.phys = Vitesse;
  output(ID_201);
}