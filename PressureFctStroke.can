/*@!Encoding:1252*/

variables
{
  msTimer Timer_1;
  msTimer Timer_2;
  msTimer Timer_3;
  msTimer Timer_4;
  msTimer Timer_5;
  msTimer Timer_6;
  msTimer Timer_7;
  msTimer Timer_8;
  msTimer Timer_9;
  msTimer Timer_10;
  
	message CAN1.Parker_advanced::ID_201      ID_201;	              //Position_target parameter frame
  message	CAN2.VW_Golf_GTE::ACW_08_11       pMC1_L;              //trigger parameter

  float triggerParam;
  int comptDummy = 0;
  
  int Vitesse = 50;
  int CourseMaintien = 4000;
  
  int pIndic = 0;
  float pCalc = 0;

  int course_45bar = 10000;
  int course_30bar = 8000;
  int course_15bar = 5000;
}

on Start
{
  ID_201.Task_Actuator.phys	=	1;
	ID_201.Position_target.phys = 0;
	ID_201.Application_speed.phys = 0;
  output(ID_201);
  write("ON START - INIT ACTUATOR");
}

on message VW_Golf_GTE::ACW_08_11
{
  pIndic = this.PMC1_L;
  pCalc = pIndic*0.0121607-1.0823;
  
  write("ON MESSAGE - INIT"); 
  write("pMC1_L value %f bar",pCalc);
  
  ID_201.Task_Actuator.phys	=	4;
	ID_201.Position_target.phys = course_45bar;
	ID_201.Application_speed.phys = Vitesse;
  output(ID_201);
  if(pCalc < 45)
  {
    course_45bar += 500;
  }
  else
  {
    course_45bar -= 500;
  }
  
  ID_201.Task_Actuator.phys	=	4;
	ID_201.Position_target.phys = course_30bar;
	ID_201.Application_speed.phys = Vitesse;
  output(ID_201);
  if(pCalc < 30)
  {
    course_30bar += 500;
  }
  else
  {
    course_30bar -= 500;
  }
  
  ID_201.Task_Actuator.phys	=	4;
	ID_201.Position_target.phys = course_15bar;
	ID_201.Application_speed.phys = Vitesse;
  output(ID_201);
  if(pCalc < 15)
  {
    course_15bar += 500;
  }
  else
  {
    course_15bar -= 500;
  }
  canSetChannelAcc(2,2,2);
  setTimer(Timer_1,500);
}

on timer Timer_1
{
  ID_201.Task_Actuator.phys	=	4;
	ID_201.Position_target.phys = course_45bar;
	ID_201.Application_speed.phys = Vitesse;
  output(ID_201);
  
  setTimer(Timer_2,5000);
}

on timer Timer_2
{
  write("timer_2");
  ID_201.Task_Actuator.phys	=	4;
	ID_201.Position_target.phys = course_30bar;
	ID_201.Application_speed.phys = Vitesse;
  output(ID_201);
  
  setTimer(Timer_3, 500);
}

on timer Timer_3
{
  ID_201.Task_Actuator.phys	=	4;
  ID_201.Position_target.phys = course_30bar;
  ID_201.Application_speed.phys = Vitesse;
  output(ID_201);
 
  setTimer(Timer_4, 5000);
}

on timer Timer_4
{
  ID_201.Task_Actuator.phys	=	4;
  ID_201.Position_target.phys = course_15bar;
  ID_201.Application_speed.phys = Vitesse;
  output(ID_201);
 
  setTimer(Timer_4, 500); 
}

on timer Timer_5
{
  ID_201.Task_Actuator.phys	=	4;
  ID_201.Position_target.phys = course_15bar;
  ID_201.Application_speed.phys = Vitesse;
  output(ID_201); 
  
  setTimer(Timer_6, 5000);
}

on timer Timer_6
{
  ID_201.Task_Actuator.phys	=	4;
  ID_201.Position_target.phys = course_30bar;
  ID_201.Application_speed.phys = Vitesse;
  output(ID_201); 
  
  setTimer(Timer_7, 500);
}

on timer Timer_7
{
  ID_201.Task_Actuator.phys	=	4;
  ID_201.Position_target.phys = course_30bar;
  ID_201.Application_speed.phys = Vitesse;
  output(ID_201); 
  
  setTimer(Timer_8, 2500);
}

on timer Timer_8
{
  ID_201.Task_Actuator.phys	=	4;
  ID_201.Position_target.phys = 0;
  ID_201.Application_speed.phys = Vitesse;
  output(ID_201); 
  
  setTimer(Timer_9, 500);
}

on timer Timer_9
{
  comptDummy ++;
  if(comptDummy%3 == 0)
  {
    setTimer(Timer_10,60000);
    resetCanEx(2);
  }

  setTimer(Timer_1, 7000);
}

on timer Timer_10
{
  setTimer(Timer_1, 7000);
}

on key's' 
{
  cancelTimer(Timer_1);
  cancelTimer(Timer_2);
  cancelTimer(Timer_3);
  cancelTimer(Timer_4);
  cancelTimer(Timer_5);
  
  write("Stop script");
  
  ID_201.Task_Actuator.phys	=	4;
	ID_201.Position_target.phys = 0;
	ID_201.Application_speed.phys = Vitesse;
  output(ID_201); 
}
